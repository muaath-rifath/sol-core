## firmware/main/Kconfig.projbuild
```kconfig
menu "Smart Home Demo Configuration"

    config WIFI_SSID
        string "WiFi SSID"
        default "MyNetwork"

    config WIFI_PASSWORD
        string "WiFi Password"
        default "MyPassword"

    config MQTT_BROKER_URI
        string "MQTT Broker URI"
        default "mqtt://192.168.1.100:1883"

    config MQTT_USERNAME
        string "MQTT Username"
        default ""

    config MQTT_PASSWORD
        string "MQTT Password"
        default ""

    config DEVICE_ID
        string "Device ID"
        default "esp32-led-001"

    config VOICE_MIC_PEAK_LOG
        bool "Log mic peak amplitude every ~2 s (audio debug)"
        default n
        help
          When enabled, afe_feed_task prints the peak int16 sample value
          from each ~2-second window. Useful for verifying the INMP441 mic
          is producing audio before wake-word testing. Disable for production.

endmenu
```

## firmware/sdkconfig.defaults
```kconfig
CONFIG_PARTITION_TABLE_CUSTOM=y
CONFIG_PARTITION_TABLE_CUSTOM_FILENAME="partitions.csv"
CONFIG_MQTT_PROTOCOL_5=y
CONFIG_BOOTLOADER_APP_ROLLBACK_ENABLE=y
CONFIG_ESPTOOLPY_FLASHSIZE_16MB=y
CONFIG_ESPTOOLPY_FLASHMODE_DIO=y
CONFIG_ESPTOOLPY_FLASHFREQ_80M=y
CONFIG_WIFI_SSID=""
CONFIG_WIFI_PASSWORD=""
CONFIG_MQTT_BROKER_URI="mqtts://mqtt.sol.muaathrifath.me:8883"
CONFIG_DEVICE_ID=""

# PSRAM — required by esp-sr (AFE buffers) and LiveKit SDK
CONFIG_SPIRAM=y
CONFIG_SPIRAM_USE_MALLOC=y
CONFIG_SPIRAM_MODE_OCT=y
CONFIG_SPIRAM_SPEED_80M=y
CONFIG_ESP_DEFAULT_CPU_FREQ_MHZ_240=y

# esp-sr AFE + WakeNet
CONFIG_MODEL_IN_FLASH=y
CONFIG_AFE_INTERFACE_V1=y
CONFIG_SR_NSN_WEBRTC=y
CONFIG_SR_VADN_WEBRTC=y
CONFIG_SR_WN_WN9_HIJOY_TTS=y

# LiveKit WebRTC DTLS-SRTP
CONFIG_MBEDTLS_SSL_PROTO_DTLS=y
CONFIG_MBEDTLS_SSL_DTLS_SRTP=y
```
